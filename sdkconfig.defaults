## sdkconfig.defaults
```kconfig
CONFIG_IDF_TARGET="esp32p4"

# Watchdogs fire when the CPU is halted by the debugger (interrupts stop).
# Disable both so breakpoints don't cause a system reset.
CONFIG_ESP_INT_WDT=n
CONFIG_ESP_TASK_WDT_INIT=n

# USB CDC — device appears as "PDMKit_Controller" in Device Manager
CONFIG_TINYUSB_CDC_ENABLED=y
CONFIG_TINYUSB_DESC_MANUFACTURER_STRING="PDMKit"
CONFIG_TINYUSB_DESC_PRODUCT_STRING="PDMKit_Controller"
CONFIG_TINYUSB_DESC_SERIAL_STRING="PDM-001"
CONFIG_TINYUSB_DESC_CDC_STRING="PDMKit CDC"
```
